## sdkconfig.defaults
```kconfig
CONFIG_ESP32_DEFAULT_CPU_FREQ_240=y
CONFIG_ESP32_DEFAULT_CPU_FREQ_MHZ=240
CONFIG_ESPTOOLPY_FLASHFREQ_80M=y
CONFIG_ESP_MAIN_TASK_STACK_SIZE=16384
CONFIG_ESP_SYSTEM_CHECK_INT_LEVEL_5=y
CONFIG_ESP_INT_WDT_TIMEOUT_MS=300
CONFIG_FREERTOS_IDLE_TASK_STACKSIZE=1024
CONFIG_ESP_SYSTEM_EVENT_TASK_STACK_SIZE=3072
CONFIG_IDF_TARGET_ESP32=y
CONFIG_ESP32_REV_MIN_3=y

#
# Secure Boot v2
#
#CONFIG_SECURE_BOOT=y
#CONFIG_SECURE_BOOT_SUPPORTS_RSA=y
#CONFIG_SECURE_BOOT_VS_ENABLED=y
#CONFIG_SECURE_BOOT_BUILD_SIGNED_BINARIES=n
#CONFIG_BOOTLOADER_LOG_LEVEL_WARN=y


#
# Encryption config
#CONFIG_SECURE_FLASH_ENC_ENABLED=y
#CONFIG_SECURE_FLASH_UART_BOOTLOADER_ALLOW_ENC=y
#CONFIG_NVS_ENCRYPTION=y
#

#
# Efuse Settings for Development
#
CONFIG_EFUSE_VIRTUAL=y
CONFIG_EFUSE_VIRTUAL_KEEP_IN_FLASH=y

#
# Serial flasher config
#
CONFIG_ESPTOOLPY_FLASHSIZE_8MB=y
CONFIG_ESPTOOLPY_FLASHSIZE="8MB"
# end of Serial flasher config

#
# Partition Table
#
CONFIG_PARTITION_TABLE_CUSTOM=y
CONFIG_PARTITION_TABLE_FILENAME="partitions.csv"
CONFIG_PARTITION_TABLE_OFFSET=0xB000
# end of Partition Table

#
# SPI configuration
#
CONFIG_SPI_MASTER_ISR_IN_IRAM=n
CONFIG_SPI_SLAVE_ISR_IN_IRAM=n
# end of SPI configuration


#
# SPI RAM config
#
#CONFIG_ESP32_SPIRAM_SUPPORT=y
#CONFIG_SPIRAM_BOOT_INIT=y
#CONFIG_SPIRAM_USE_MALLOC=y
#CONFIG_SPIRAM_SPEED_80M=y
#CONFIG_SPIRAM_MALLOC_ALWAYSINTERNAL=4096
#CONFIG_SPIRAM_MALLOC_RESERVE_INTERNAL=18432
#CONFIG_SPIRAM_ALLOW_BSS_SEG_EXTERNAL_MEMORY=y
#CONFIG_SPIRAM_ALLOW_STACK_EXTERNAL_MEMORY=y
#CONFIG_SPIRAM_TRY_ALLOCATE_WIFI_LWIP=y


#
# Common ESP-related
#
#CONFIG_ESP_ALLOW_BSS_SEG_EXTERNAL_MEMORY=y
# end of Common ESP-related

#
# Wi-Fi
#
CONFIG_ESP32_WIFI_STATIC_RX_BUFFER_NUM=9
CONFIG_ESP32_WIFI_DYNAMIC_RX_BUFFER_NUM=128
CONFIG_ESP32_WIFI_STATIC_TX_BUFFER_NUM=9
CONFIG_ESP32_WIFI_IRAM_OPT=n
CONFIG_ESP32_WIFI_RX_IRAM_OPT=n
CONFIG_MBEDTLS_EXTERNAL_MEM_ALLOC=y
# end of Wi-Fi

#
# UDP
#
CONFIG_LWIP_MAX_UDP_PCBS=64
CONFIG_LWIP_UDP_RECVMBOX_SIZE=64
CONFIG_LWIP_TCPIP_TASK_STACK_SIZE=3072

#
# FreeRTOS
#
CONFIG_FREERTOS_PLACE_FUNCTIONS_INTO_FLASH=y
CONFIG_FREERTOS_PLACE_SNAPSHOT_FUNS_INTO_FLASH=y
# end of FreeRTOS

#
# mbedTLS
#
CONFIG_WPA_MBEDTLS_CRYPTO=n
CONFIG_MBEDTLS_INTERNAL_MEM_ALLOC=n
#CONFIG_MBEDTLS_EXTERNAL_MEM_ALLOC=y
CONFIG_MBEDTLS_ECDH_LEGACY_CONTEXT=y
CONFIG_MBEDTLS_ECP_RESTARTABLE=y
CONFIG_MBEDTLS_CMAC_C=y
# end of mbedTLS
```
